#include "LPC213x.H"
#include "type.h"
#include "spi.h"
#include "LCD.h"

const unsigned char tab_font[ ] = 
{
 0x00, 0x00, 0x00, 0x00, 0x00,   // sp  
 0x00, 0x00, 0x2f, 0x00, 0x00,   // !  
 0x00, 0x07, 0x00, 0x07, 0x00,   // "  
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 0x08, 0x10, 0x08, 0x04, 0x08    // ~  
};

 
/********************************/
/* Write Data or Command to LCD */
/* D/C = "0" = Write Command    */
/* D/C = "1" = Write Display    */
/********************************/ 
void lcd_write_data(unsigned char DataByte) 
{                
  LCD5110_DC_HIGH(); 											// Active DC = High("1"=Data)
  LCD5110_SCE_LOW();											// SCE = Low(Enable)

  SPI_Send(&DataByte,1);										// Send SPI to LCD Nokia-5110
   																
  LCD5110_SCE_HIGH();											// SCE = HIGH(Disable)
}    

/********************************/
/* Write Data or Command to LCD */
/* D/C = "0" = Write Command    */
/* D/C = "1" = Write Display    */
/********************************/ 
void lcd_write_command(unsigned char CommandByte) 
{                

  LCD5110_DC_LOW(); 											// Active DC = Low("0"=Command)
  LCD5110_SCE_LOW();											// SCE = Low(Enable)
												 
  SPI_Send(&CommandByte,1);										// Send SPI to LCD Nokia-5110
																
  LCD5110_SCE_HIGH();											// SCE = HIGH(Disable)
}    

/**************************/
/* Initial LCD Nokia-5110 */
/**************************/          
void lcd_initial(void)      
{
  PINSEL1 &= 0x3FFF33FF;                                		// set pin 0.21 0.23 0.31 as GPIO 
  
  IODIR0  |= LCD5110_DC_PIN;									// D/C   = Output Control LCD Nokia-5110
  IODIR0  |= LCD5110_RES_PIN;									// RES   = Output Control LCD Nokia-5110
  IODIR0  |= LCD5110_SCE_PIN;								    // SCE   = Output Control LCD Nokia-5110

  LCD5110_RES_LOW();											// Active Reset
  LCD5110_RES_HIGH();											// Normal Operation  
  LCD5110_DC_HIGH();   											// Active DC = High("1"=Data)
  LCD5110_RES_LOW();											// Active Reset
  LCD5110_RES_HIGH();											// Normal Operation

  lcd_write_command(32+1);       								// Function Set = Extend Instruction(00100+PD,V,H=00100+0,0,1)
  lcd_write_command(128+38);     								// Set VOP(1+VOP[6..0] = 1+0100110)
  lcd_write_command(4+3);            							// Temp Control(000001+TC1,TC0=000001+1,1)
  lcd_write_command(16+3);       								// Bias System(00010,BS2,BS1,BS0=00010,0,1,1)

  lcd_write_command(32+0);       								// Function Set = Basic Instruction(00100+PD,V,H = 00100+0,0,0)
  lcd_write_command(12);         								// Display Control = Normal Mode(00001D0E=00001100)
}   

/****************************/
/* Clear Screen Display LCD */
/****************************/
void lcd_clear_screen(void)       
{  
  unsigned int  i=0;   											// Memory Display(Byte) Counter
    
  lcd_write_command(128+0);       								// Set X Position = 0(0..83)
  lcd_write_command(64+0);         								// Set Y Position = 0(0..5)
  
  for(i=0;i<504;i++)   											// All Display RAM = 504 Byte  
  lcd_write_data(0);  											// Clear Screen Display
}   

/****************************/
/* Fill Picture Display LCD */
/****************************/
void lcd_fill_picture(unsigned char picture[])       
{  
  unsigned int  i=0;   													// Memory Display(Byte) Counter
    
  lcd_write_command(128+0);       										// Set X Position = 0(0..83)
  lcd_write_command(64+0);         										// Set Y Position = 0(0..5)
  																	
  for(i=0;i<504;i++)   													// All Display RAM = 504 Byte  
  lcd_write_data(picture[i]); 											// Fill Picture Display
}      

/***************************/
/* Set Cursor X,Y Position */
/* X[0-83]: 84 Column Data */
/* Y[0-5] : 6 Row(48 Dot)  */
/***************************/
void lcd_gotoxy(unsigned char x,unsigned char y)  
{  
  lcd_write_command(128+x);  	 								// Set X Position(1+x6,x5,x4,x3,x2,x1,x0)
  lcd_write_command(64+y);  									// Set Y Position(01000+y2,y1,y0)
}  

/***************************/
/* Put Char to LCD Display */
/***************************/
void lcd_put_char(unsigned char character) 
{  
  unsigned char font_size_count = 0;  							// Font Size Counter
  unsigned int  font_data_index;  								// Font Data Pointer

  font_data_index = character-32;      							// Skip 0x00..0x1F Font Code
  font_data_index = font_data_index*5;  						// 5 Byte / Font       
  
  while(font_size_count<5)                          			// Get 5 Byte Font & Display on LCD
  {  													
    lcd_write_data(tab_font[font_data_index]);    				// Get Data of Font From Table & Write LCD
    font_size_count++;  										// Next Byte Counter
    font_data_index++;  										// Next	Byte Pointer
  }  
  lcd_write_data(0);											// 1 Pixel Dot Space
}    

/*******************************/
/* Print String to LCD Display */
/*******************************/
void lcd_print_string(unsigned char *string , unsigned char CharCount) 
{          
  unsigned char i=0;  											// Dummy Character Count

  while(i<CharCount)  
  {    
    lcd_put_char(string[i]);									// Print 1-Char to LCD
    i++;                           								// Next Character Print
  }  
}
